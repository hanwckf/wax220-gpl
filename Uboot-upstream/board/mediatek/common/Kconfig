## Uboot-upstream/board/mediatek/common/Kconfig
```kconfig
config MEDIATEK_BOOTMENU
	bool "Enable MediaTek bootmenu framework"
	select CMD_BOOTMENU
	default n
	help
	  Enable this option will allow boards to use a bootmenu containing
	  features for easy upgrading/booting.

config MEDIATEK_BOOTMENU_COUNTDOWN
	bool "Enable bootmenu countdown"
	default y
	depends on MEDIATEK_BOOTMENU
	help
	  Enable bootmenu auto-booting countdown timer.

config MEDIATEK_BOOTMENU_DELAY
	int "MediaTek bootmenu delay time (s)"
	range 1 10
	default 4
	depends on MEDIATEK_BOOTMENU_COUNTDOWN
	help
	  The dealy seconds for the bootmenu to show before running the
	  default command.

config MEDIATEK_LOAD_FROM_RAM
	bool "Enable loading from RAM support"
	default n
	depends on MEDIATEK_BOOTMENU
	help
	  Enable loading from RAM support for mtkload and mtkupgrade. This is
	  useful when using JTAG debugging and ethernet is not available.

config MTK_SECURE_BOOT
	bool "Enable MediaTek secure boot framework"
	select FIT_SIGNATURE
	select ENV_IS_NOWHERE
	select CHAIN_OF_TRUST
	default n
	help
	  Enable this option will allow boards to verify Linux and Filesystem.

config CHAIN_OF_TRUST
	bool
	default n

config MTK_ANTI_ROLLBACK
	bool "Enable MediaTek anti-rollback framework"
	default n
	depends on MTK_SECURE_BOOT
	help
	  Enable this option will allow boards to verify Firmware Anti-rollback
	  Version.
```

## package/tw/product_config/Config.in
```kconfig
if PACKAGE_product_config
config PRODUCT_NTGR_ROUTER_WAX206
	bool "Netgear Router WAX206"
	default n
	depends on PACKAGE_product_config

config PRODUCT_NTGR_ROUTER_WAX202
	bool "Netgear Router WAX202"
	default n
	depends on PACKAGE_product_config

config PRODUCT_NTGR_AP_WAX214v2
    bool "Netgear AP WAX214v2"
    default n
    depends on PACKAGE_product_config

config PRODUCT_NTGR_AP_WAX220
    bool "Netgear AP WAX220"
    default n
    depends on PACKAGE_product_config
endif #PACKAGE_product_config#
```
